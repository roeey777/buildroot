## boot/cboot/Config.in
```kconfig
config BR2_CBOOT
	bool "CBoot"
	help
	  Build Nvidia's bootloader for Jetson & Xavier boards.
	  
	  CBoot is the primary CPU boot loader used on mobile platforms in the cold boot path.
	  CBoot is feature-rich boot loader used for cold boot.
	  In addition to booting the kernel, it also supports display, boot logo, and verified boot.

	  CBoot is based on the Little Kernel (LK) open source boot loader.
	  CBoot primarily uses the interrupt and scheduling frameworks of LK.
	  Cboot uses CDF for frameworks, drivers, and libraries.

if BR2_CBOOT

config BR2_CBOOT_NVIDIA_BOARD_TYPE
	string "nvidia board type"
	default "t186"
	help
	  CBoot is a bootloader only for some of Nvidia's boards such as Jetson TX2/TX2i & Xavier.
	  The only available options are: t186 & t194.

endif
```

## configs/jetson_tx2_defconfig
```kconfig
BR2_aarch64=y
BR2_cortex_a57=y
BR2_ARM_FPU_VFPV4=y
BR2_CCACHE=y
BR2_GLOBAL_PATCH_DIR="board/tegra/t186/patches"
BR2_PIC_PIE=y
BR2_TOOLCHAIN_BUILDROOT_GLIBC=y
BR2_PACKAGE_HOST_LINUX_HEADERS_CUSTOM_4_9=y
BR2_BINUTILS_VERSION_2_33_X=y
BR2_GCC_VERSION_7_X=y
BR2_TOOLCHAIN_BUILDROOT_CXX=y
BR2_GCC_ENABLE_LTO=y
BR2_PACKAGE_HOST_GDB=y
BR2_INIT_SYSV=y
BR2_SYSTEM_BIN_SH_BASH=y
BR2_SYSTEM_DHCP="eth0"
BR2_LINUX_KERNEL=y
BR2_LINUX_KERNEL_CUSTOM_GIT=y
BR2_LINUX_KERNEL_CUSTOM_REPO_URL="https://github.com/madisongh/linux-tegra-4.9"
BR2_LINUX_KERNEL_CUSTOM_REPO_VERSION="f03f5aa305c2437c75eb5708816ca90d2f2a3fe1"
BR2_LINUX_KERNEL_USE_CUSTOM_CONFIG=y
BR2_LINUX_KERNEL_CUSTOM_CONFIG_FILE="board/tegra/t186/kernel_defconfig"
BR2_LINUX_KERNEL_DTS_SUPPORT=y
BR2_LINUX_KERNEL_INTREE_DTS_NAME="_ddot_/_ddot_/_ddot_/_ddot_/nvidia/platform/t18x/quill/kernel-dts/tegra186-quill-p3310-1000-c03-00-base"
BR2_LINUX_KERNEL_INSTALL_TARGET=y
BR2_LINUX_KERNEL_NEEDS_HOST_OPENSSL=y
BR2_PACKAGE_GSTREAMER1=y
BR2_PACKAGE_GST1_PLUGINS_GOOD=y
BR2_PACKAGE_GST1_PYTHON=y
BR2_PACKAGE_UNRAR=y
BR2_PACKAGE_UNZIP=y
BR2_PACKAGE_LSOF=y
BR2_PACKAGE_LTRACE=y
BR2_PACKAGE_STRACE=y
BR2_PACKAGE_VALGRIND=y
BR2_PACKAGE_BSDIFF=y
BR2_PACKAGE_CHECK=y
BR2_PACKAGE_DOS2UNIX=y
BR2_PACKAGE_GREP=y
BR2_PACKAGE_SED=y
BR2_PACKAGE_TREE=y
BR2_PACKAGE_CIFS_UTILS=y
BR2_PACKAGE_MMC_UTILS=y
BR2_PACKAGE_SSHFS=y
BR2_PACKAGE_PYTHON3=y
BR2_PACKAGE_PYTHON3_READLINE=y
BR2_PACKAGE_PYTHON3_SQLITE=y
BR2_PACKAGE_PYTHON_AIOCOAP=y
BR2_PACKAGE_PYTHON_AIOCONSOLE=y
BR2_PACKAGE_PYTHON_AIOHTTP_CORS=y
BR2_PACKAGE_PYTHON_DATEUTIL=y
BR2_PACKAGE_PYTHON_ESPTOOL=y
BR2_PACKAGE_PYTHON_FIRE=y
BR2_PACKAGE_PYTHON_IPYTHON=y
BR2_PACKAGE_PYTHON_LXML=y
BR2_PACKAGE_PYTHON_NUMPY=y
BR2_PACKAGE_PYTHON_PROTOBUF=y
BR2_PACKAGE_PYTHON_PSUTIL=y
BR2_PACKAGE_PYTHON_PYELFTOOLS=y
BR2_PACKAGE_PYTHON_PYINOTIFY=y
BR2_PACKAGE_PYTHON_PYUSB=y
BR2_PACKAGE_PYTHON_PYZMQ=y
BR2_PACKAGE_PYTHON_REENTRY=y
BR2_PACKAGE_PYTHON_REQUESTS=y
BR2_PACKAGE_PYTHON_SCAPY=y
BR2_PACKAGE_PYTHON_SERIAL_ASYNCIO=y
BR2_PACKAGE_PYTHON_SPIDEV=y
BR2_PACKAGE_PYTHON_UVLOOP=y
BR2_PACKAGE_BC=y
BR2_PACKAGE_COLLECTD=y
BR2_PACKAGE_COLLECTD_EMPTY_COUNTER=y
BR2_PACKAGE_COLLECTD_HASHED=y
BR2_PACKAGE_COLLECTD_REGEX=y
BR2_PACKAGE_COLLECTD_TIMEDIFF=y
BR2_PACKAGE_COLLECTD_VALUE=y
BR2_PACKAGE_COLLECTD_AGGREGATION=y
BR2_PACKAGE_COLLECTD_LOGSTASH=y
BR2_PACKAGE_COLLECTD_NOTIFY_EMAIL=y
BR2_PACKAGE_COLLECTD_NOTIFY_NAGIOS=y
BR2_PACKAGE_COLLECTD_THRESHOLD=y
BR2_PACKAGE_COLLECTD_APACHE=y
BR2_PACKAGE_COLLECTD_APCUPS=y
BR2_PACKAGE_COLLECTD_BATTERY=y
BR2_PACKAGE_COLLECTD_BIND=y
BR2_PACKAGE_COLLECTD_CEPH=y
BR2_PACKAGE_COLLECTD_CHRONY=y
BR2_PACKAGE_COLLECTD_CGROUPS=y
BR2_PACKAGE_COLLECTD_CONNTRACK=y
BR2_PACKAGE_COLLECTD_CONTEXTSWITCH=y
BR2_PACKAGE_COLLECTD_CPU=y
BR2_PACKAGE_COLLECTD_CPUFREQ=y
BR2_PACKAGE_COLLECTD_CPUSLEEP=y
BR2_PACKAGE_COLLECTD_CURL=y
BR2_PACKAGE_COLLECTD_CURL_JSON=y
BR2_PACKAGE_COLLECTD_CURL_XML=y
BR2_PACKAGE_COLLECTD_DF=y
BR2_PACKAGE_COLLECTD_DISK=y
BR2_PACKAGE_COLLECTD_DNS=y
BR2_PACKAGE_COLLECTD_DRBD=y
BR2_PACKAGE_COLLECTD_ENTROPY=y
BR2_PACKAGE_COLLECTD_ETHSTAT=y
BR2_PACKAGE_COLLECTD_EXEC=y
BR2_PACKAGE_COLLECTD_FHCOUNT=y
BR2_PACKAGE_COLLECTD_FILECOUNT=y
BR2_PACKAGE_COLLECTD_FSCACHE=y
BR2_PACKAGE_COLLECTD_GPS=y
BR2_PACKAGE_COLLECTD_HUGEPAGES=y
BR2_PACKAGE_COLLECTD_INTERFACE=y
BR2_PACKAGE_COLLECTD_IPC=y
BR2_PACKAGE_COLLECTD_IPTABLES=y
BR2_PACKAGE_COLLECTD_IPVS=y
BR2_PACKAGE_COLLECTD_IRQ=y
BR2_PACKAGE_COLLECTD_LOAD=y
BR2_PACKAGE_COLLECTD_LVM=y
BR2_PACKAGE_COLLECTD_MD=y
BR2_PACKAGE_COLLECTD_MEMCACHEC=y
BR2_PACKAGE_COLLECTD_MEMCACHED=y
BR2_PACKAGE_COLLECTD_MEMORY=y
BR2_PACKAGE_COLLECTD_MODBUS=y
BR2_PACKAGE_COLLECTD_MYSQL=y
BR2_PACKAGE_COLLECTD_NETLINK=y
BR2_PACKAGE_COLLECTD_NFS=y
BR2_PACKAGE_COLLECTD_NGINX=y
BR2_PACKAGE_COLLECTD_NTPD=y
BR2_PACKAGE_COLLECTD_OLSRD=y
BR2_PACKAGE_COLLECTD_ONEWIRE=y
BR2_PACKAGE_COLLECTD_OPENLDAP=y
BR2_PACKAGE_COLLECTD_OPENVPN=y
BR2_PACKAGE_COLLECTD_PING=y
BR2_PACKAGE_COLLECTD_POSTGRESQL=y
BR2_PACKAGE_COLLECTD_PROCESSES=y
BR2_PACKAGE_COLLECTD_PROTOCOLS=y
BR2_PACKAGE_COLLECTD_REDIS=y
BR2_PACKAGE_COLLECTD_SENSORS=y
BR2_PACKAGE_COLLECTD_SERIAL=y
BR2_PACKAGE_COLLECTD_STATSD=y
BR2_PACKAGE_COLLECTD_SNMP=y
BR2_PACKAGE_COLLECTD_SWAP=y
BR2_PACKAGE_COLLECTD_TABLE=y
BR2_PACKAGE_COLLECTD_TAIL=y
BR2_PACKAGE_COLLECTD_TAIL_CSV=y
BR2_PACKAGE_COLLECTD_TCPCONNS=y
BR2_PACKAGE_COLLECTD_THERMAL=y
BR2_PACKAGE_COLLECTD_UPTIME=y
BR2_PACKAGE_COLLECTD_USERS=y
BR2_PACKAGE_COLLECTD_VMEM=y
BR2_PACKAGE_COLLECTD_WIRELESS=y
BR2_PACKAGE_COLLECTD_ZOOKEEPER=y
BR2_PACKAGE_COLLECTD_NOTIFICATION=y
BR2_PACKAGE_COLLECTD_REPLACE=y
BR2_PACKAGE_COLLECTD_SCALE=y
BR2_PACKAGE_COLLECTD_SET=y
BR2_PACKAGE_COLLECTD_AMQP=y
BR2_PACKAGE_COLLECTD_CSV=y
BR2_PACKAGE_COLLECTD_GRAPHITE=y
BR2_PACKAGE_COLLECTD_GRPC=y
BR2_PACKAGE_COLLECTD_MQTT=y
BR2_PACKAGE_COLLECTD_NETWORK=y
BR2_PACKAGE_COLLECTD_NETWORK_GCRYPT=y
BR2_PACKAGE_COLLECTD_RRDTOOL=y
BR2_PACKAGE_COLLECTD_RIEMANN=y
BR2_PACKAGE_COLLECTD_UNIXSOCK=y
BR2_PACKAGE_COLLECTD_WRITEHTTP=y
BR2_PACKAGE_COLLECTD_WRITELOG=y
BR2_PACKAGE_COLLECTD_WRITEPROMETHEUS=y
BR2_PACKAGE_COLLECTD_WRITEREDIS=y
BR2_PACKAGE_COLLECTD_WRITESENSU=y
BR2_PACKAGE_COLLECTD_WRITETSDB=y
BR2_PACKAGE_BLUEZ5_UTILS=y
BR2_PACKAGE_BLUEZ5_UTILS_CLIENT=y
BR2_PACKAGE_BRIDGE_UTILS=y
BR2_PACKAGE_CAN_UTILS=y
BR2_PACKAGE_CONNTRACK_TOOLS=y
BR2_PACKAGE_DROPBEAR=y
BR2_PACKAGE_ETHTOOL=y
BR2_PACKAGE_IFTOP=y
BR2_PACKAGE_IFUPDOWN=y
BR2_PACKAGE_IPERF3=y
BR2_PACKAGE_IPUTILS=y
BR2_PACKAGE_IW=y
BR2_PACKAGE_IWD=y
BR2_PACKAGE_OPENVPN=y
BR2_PACKAGE_OPENVPN_SMALL=y
BR2_PACKAGE_PHYTOOL=y
BR2_PACKAGE_RSYNC=y
BR2_PACKAGE_SOCAT=y
BR2_PACKAGE_TCPDUMP=y
BR2_PACKAGE_TCPDUMP_SMB=y
BR2_PACKAGE_WPA_SUPPLICANT=y
BR2_PACKAGE_BASH_COMPLETION=y
BR2_PACKAGE_FILE=y
BR2_PACKAGE_LOGROTATE=y
BR2_PACKAGE_TIME=y
BR2_PACKAGE_TMUX=y
BR2_PACKAGE_WHICH=y
BR2_PACKAGE_KMOD=y
BR2_PACKAGE_KMOD_TOOLS=y
BR2_PACKAGE_MENDER=y
BR2_PACKAGE_MONIT=y
BR2_PACKAGE_RAUC=y
BR2_PACKAGE_RAUC_NETWORK=y
BR2_PACKAGE_RAUC_JSON=y
BR2_PACKAGE_RSYSLOG=y
BR2_PACKAGE_SWUPDATE=y
BR2_PACKAGE_SYSKLOGD=y
BR2_PACKAGE_TAR=y
BR2_PACKAGE_LESS=y
BR2_PACKAGE_VIM=y
BR2_TARGET_ROOTFS_EXT2=y
BR2_TARGET_ROOTFS_EXT2_4=y
BR2_TARGET_ROOTFS_EXT2_SIZE="120M"
# BR2_TARGET_ROOTFS_TAR is not set
BR2_TARGET_ARM_TRUSTED_FIRMWARE=y
BR2_TARGET_ARM_TRUSTED_FIRMWARE_PLATFORM="t186"
BR2_CBOOT=y
BR2_TARGET_UBOOT=y
BR2_TARGET_UBOOT_BOARDNAME="p2771-0000-500"
BR2_TARGET_UBOOT_CUSTOM_GIT=y
BR2_TARGET_UBOOT_CUSTOM_REPO_URL="https://github.com/madisongh/u-boot-tegra"
BR2_TARGET_UBOOT_CUSTOM_REPO_VERSION="cb3a8fe9d7536cc222988b3b81de8488ce31f336"
BR2_TARGET_UBOOT_NEEDS_DTC=y
BR2_TARGET_UBOOT_FORMAT_DTB_BIN=y
BR2_PACKAGE_HOST_CMAKE=y
BR2_PACKAGE_HOST_DOS2UNIX=y
BR2_PACKAGE_HOST_MENDER_ARTIFACT=y
BR2_PACKAGE_HOST_OPENOCD=y
BR2_PACKAGE_HOST_PYTHON3=y
BR2_PACKAGE_HOST_RAUC=y
```
